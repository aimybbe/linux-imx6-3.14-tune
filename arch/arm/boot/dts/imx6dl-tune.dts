/*
 * Copyright (C) 2014 Rabeeh Khoury (rabeeh@solid-run.com)
 * Copyright (C) 2015 Simon Stürz <simon.stuerz@guh.guru>
 * Based on work by Russell King
 */

/dts-v1/;

#include "imx6dl.dtsi"
#include "imx6qdl-hummingboard.dtsi"

/ {
        model = "Tune";
        compatible = "guh,tune/dl", "fsl,imx6dl";
};
